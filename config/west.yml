## config/west.yml
```yaml
manifest:
  remotes:
    - name: zmkfirmware
      url-base: https://github.com/zmkfirmware
    - name: vibefae                         #new entry
      url-base: https://github.com/vibefae  #new entry
  projects:
    - name: zmk
      remote: zmkfirmware
      revision: main
      import: app/west.yml
    - name: nice-view-mod   #new entry
      remote: vibefae                       #new entry
      revision: main                      #new entry
  self:
    path: config
```
